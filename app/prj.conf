## CMakeLists.txt
```
#-------------------------------------------------------------------------------
# Zephyr Example Application
#
# Copyright (c) 2021 Nordic Semiconductor ASA
# SPDX-License-Identifier: Apache-2.0

cmake_minimum_required(VERSION 3.13.1)
find_package(Zephyr REQUIRED HINTS $ENV{ZEPHYR_BASE})

project(app LANGUAGES C)

zephyr_include_directories(src)

target_sources(app PRIVATE src/main.c)
target_sources(app PRIVATE src/dog.c)
```

## prj.conf
```kconfig
# Copyright (c) 2021 Nordic Semiconductor ASA
# SPDX-License-Identifier: Apache-2.0
#
# This file contains selected Kconfig options for the application.

CONFIG_GPIO=y
CONFIG_PWM=y
CONFIG_SMF=y
CONFIG_SYSTEM_WORKQUEUE_STACK_SIZE=2048
CONFIG_BT=y
CONFIG_BT_PERIPHERAL=y
CONFIG_BT_DEVICE_NAME="1231 EIE BLE Peripheral"
```

## src/main.c
```c
/**
 * @file main.c
 */

#include <inttypes.h>

#include <zephyr/kernel.h>
#include <zephyr/sys/printk.h>
#include <zephyr/device.h>
#include <zephyr/drivers/display.h>

#include <lvgl.h>

#include "BTN.h"
#include "LED.h"
#include "lv_data_obj.h"

#define SLEEP_MS 1

static const struct device *display_dev = DEVICE_DT_GET(DT_CHOSEN(zephyr_display));
static lv_obj_t *screen = NULL;

extern const lv_image_dsc_t dog;

void lv_button_callback(lv_event_t *event) {
    lv_obj_t *data_obj = (lv_obj_t *)lv_event_get_user_data(event);
    led_id led = *(led_id *)lv_data_obj_get_data_ptr(data_obj);

    // LED_toggle(led);

}

int main(void) {
    if (!device_is_ready(display_dev)){
        return 0;
    }
    screen = lv_screen_active();
    if (screen == NULL) {
        return 0;
    }


  if (0 > BTN_init()) {
    return 0;
  }
  if (0 > LED_init()) {
    return 0;
  }

    lv_obj_t *image = lv_image_create(screen);
    lv_image_set_src(image, &dog);
    lv_obj_align(image, LV_ALIGN_CENTER, 0, 0);

//   for (uint8_t i = 0; i < NUM_LEDS; i++) {
//     lv_obj_t *ui_btn = lv_button_create(screen);
//     lv_obj_align(ui_btn, LV_ALIGN_CENTER, 50 * (i % 2 ? 1 : -1), 20 * (i < 2 ? -1 : 1));
//     lv_obj_t *button_label = lv_label_create(ui_btn);
//     char label_text[10];
//     snprintf(label_text, 10, "LED %d", i);
//     lv_label_set_text(button_label, label_text);
//     lv_obj_align(button_label, LV_ALIGN_CENTER, 0, 0);

//     led_id led = (led_id)i;
//     lv_obj_t *data_obj = lv_data_obj_create_alloc_assign(ui_btn, &led, sizeof(led_id));
//     lv_obj_add_event_cb(ui_btn, lv_button_callback, LV_EVENT_CLICKED, data_obj);
//   }

//   lv_obj_t *label = lv_label_create(screen);
//   lv_label_set_text(label, "Hello World!");

  display_blanking_off(display_dev);
  while (1) {
    lv_timer_handler();
    k_msleep(SLEEP_MS);
  }
  return 0;
}
```

## src/my_state_machine.c
```c
/**
 * @file my_state_machine.c
 */

#include <zephyr/smf.h>
#include <zephyr/kernel.h>
#include <zephyr/sys/printk.h>
#include "LED.h"
#include "BTN.h"
#include "my_state_machine.h"

 enum led_state_machine_states {
    S0_STATE,
    S1_STATE,
    S2_STATE,
    S3_STATE,
    S4_STATE
};


typedef struct {
    struct smf_ctx ctx;     // must be first
    bool entered;
    uint32_t timer;
} led_state_object_t;


static enum smf_state_result s0_run(void *o);
static void s0_exit(void *o);

static enum smf_state_result s1_run(void *o);
static void s1_exit(void *o);

static enum smf_state_result s2_run(void *o);
static void s2_exit(void *o);

static enum smf_state_result s3_run(void *o);
static void s3_exit(void *o);

static enum smf_state_result s4_run(void *o);
static void s4_exit(void *o);


static const struct smf_state states[] = {
    [S0_STATE] = SMF_CREATE_STATE(NULL, s0_run, s0_exit, NULL, NULL),
    [S1_STATE] = SMF_CREATE_STATE(NULL, s1_run, s1_exit, NULL, NULL),
    [S2_STATE] = SMF_CREATE_STATE(NULL, s2_run, s2_exit, NULL, NULL),
    [S3_STATE] = SMF_CREATE_STATE(NULL, s3_run, s3_exit, NULL, NULL),
    [S4_STATE] = SMF_CREATE_STATE(NULL, s4_run, s4_exit, NULL, NULL),
};

static led_state_object_t led_state_object;



void state_machine_init(void) {
    led_state_object.entered = false;
    led_state_object.timer = 0;
    printk("Starting state machine at S0\n");
    smf_set_initial(SMF_CTX(&led_state_object), &states[S0_STATE]);

}


int state_machine_run(void) {
    return smf_run_state(SMF_CTX(&led_state_object));
}


static enum smf_state_result s0_run(void *o) {
    if (!led_state_object.entered) {
        printk("Entering S0: All LEDs off\n");
        LED_set(LED1, LED_OFF);
        LED_set(LED2, LED_OFF);
        LED_set(LED3, LED_OFF);
        led_state_object.entered = true;
    }

    if (BTN_is_pressed(BTN1)) {
        smf_set_state(SMF_CTX(&led_state_object), &states[S1_STATE]);
    } else if (BTN_is_pressed(BTN3)) {
        smf_set_state(SMF_CTX(&led_state_object), &states[S4_STATE]);
    }

    return SMF_EVENT_HANDLED;
}

static void s0_exit(void *o) {
    printk("Exiting S0\n");
    led_state_object.entered = false;
}

static enum smf_state_result s1_run(void *o) {
    if (!led_state_object.entered) {
        printk("Entering S1: LED1 blinking at 4 Hz\n");
        LED_blink(LED1, 4); 
        led_state_object.entered = true;
    }

    if (BTN_is_pressed(BTN2)) {
        smf_set_state(SMF_CTX(&led_state_object), &states[S2_STATE]);
    } else if (BTN_is_pressed(BTN3)) {
        smf_set_state(SMF_CTX(&led_state_object), &states[S0_STATE]);
    }

    return SMF_EVENT_HANDLED;
}

static void s1_exit(void *o) {
    printk("Exiting S1\n");
    led_state_object.entered = false;
}

static enum smf_state_result s2_run(void *o) {
    if (!led_state_object.entered) {
        printk("Entering S2: LED1 & LED3 ON, LED2 & LED3 OFF\n");
        LED_set(LED1, LED_ON);
        LED_set(LED3, LED_ON);
        LED_set(LED2, LED_OFF);
        LED_set(LED3, LED_OFF);
        led_state_object.entered = true;
        led_state_object.timer = k_uptime_get();
    }


    

    if (k_uptime_get() - led_state_object.timer >= 1000) {
        smf_set_state(SMF_CTX(&led_state_object), &states[S3_STATE]);
    } else if (BTN_is_pressed(BTN3)) {
        smf_set_state(SMF_CTX(&led_state_object), &states[S0_STATE]);
    }

    return SMF_EVENT_HANDLED;
}

static void s2_exit(void *o) {
    printk("Exiting S2\n");
    led_state_object.entered = false;
}

static enum smf_state_result s3_run(void *o) {
    if (!led_state_object.entered) {
        printk("Entering S3: LED1 & LED3 OFF, LED2 & LED3 ON\n");
        LED_set(LED1, LED_OFF);
        LED_set(LED3, LED_OFF);
        LED_set(LED2, LED_ON);
        LED_set(LED3, LED_ON);
        led_state_object.entered = true;
        led_state_object.timer = k_uptime_get();
    }


    if (k_uptime_get() - led_state_object.timer >= 2000) {  
        smf_set_state(SMF_CTX(&led_state_object), &states[S2_STATE]);
    } else if (BTN_is_pressed(BTN3)) {
        smf_set_state(SMF_CTX(&led_state_object), &states[S0_STATE]);
    }

    return SMF_EVENT_HANDLED;
}

static void s3_exit(void *o) {
    printk("Exiting S3\n");
    led_state_object.entered = false;
}

static enum smf_state_result s4_run(void *o) {
    if (!led_state_object.entered) {
        printk("Entering S4: All LEDs blinking at 16 Hz\n");
        LED_blink(LED1, 16);
        LED_blink(LED2, 16);
        LED_blink(LED3, 16);
        led_state_object.entered = true;
    }

    if (BTN_is_pressed(BTN3)) {
        smf_set_state(SMF_CTX(&led_state_object), &states[S0_STATE]);
    }

    return SMF_EVENT_HANDLED;
}

static void s4_exit(void *o) {
    printk("Exiting S4\n");
    led_state_object.entered = false;
}
```

## src/my_state_machine.h
```c
/**
 * @file my_state_machine.h
 */

 #ifndef MY_STATE_MACHINE_H
 #define MY_STATE_MACHINE_H

 void state_machine_init();

 int state_machine_run();

 #endif // MY_STATE_MACHINE_H
 
```
